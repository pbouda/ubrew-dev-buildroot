## package/qt5/qt5gamepad/Config.in
```kconfig
config BR2_PACKAGE_QT5GAMEPAD
	bool "qt5gamepad"
	select BR2_PACKAGE_QT5BASE
	select BR2_PACKAGE_QT5BASE_GUI
	help
	  Qt is a cross-platform application and UI framework for
	  developers using C++.

	  This package corresponds to the qtgamepad module in the Qt Labs.

	  http://qt.io
```

## package/ubrew/Config.in
```kconfig
source "package/ubrew/libpnd/Config.in"
source "package/ubrew/libpndman/Config.in"
source "package/ubrew/qt5pndman/Config.in"
source "package/ubrew/panorama/Config.in"
source "package/ubrew/qt5gamepad/Config.in"
```

## package/ubrew/libpnd/Config.in
```kconfig
config BR2_PACKAGE_LIBPND
	bool "libpnd"
	help
	  Device specific libraries used on the Pandora platform. 

	  https://github.com/ubrew-it/libpnd
```

## package/ubrew/libpndman/Config.in
```kconfig
config BR2_PACKAGE_LIBPNDMAN
	bool "libpndman"
	select BR2_PACKAGE_JANSSON
	help
	  Package management library for PND files.

	  https://github.com/ubrew-it/libpndman
```

## package/ubrew/panorama/Config.in
```kconfig
config BR2_PACKAGE_PANORAMA
	bool "panorama"
	select qt5pndman
	help
	  A menu system, application launcher and user interface for the OpenPandora 

	  https://github.com/ubrew-it/panorama
```

## package/ubrew/qt5gamepad/Config.in
```kconfig
config BR2_PACKAGE_QT5GAMEPAD
	bool "qt5gamepad"
	depends on BR2_PACKAGE_QT5BASE
	help
	  Qt is a cross-platform application and UI framework for
	  developers using C++.

	  This package corresponds to the qtgamepad module in the Qt Labs.

	  http://qt.io
```

## package/ubrew/qt5pndman/Config.in
```kconfig
config BR2_PACKAGE_QT5PNDMAN
	bool "qt5pndman"
	depends on BR2_PACKAGE_QT5BASE
	select BR2_PACKAGE_LIBPNDMAN
	select BR2_PACKAGE_JANSSON
	select BR2_PACKAGE_LIBCURL
	select BR2_PACKAGE_BZIP2
	help
	  Qt is a cross-platform application and UI framework for
	  developers using C++.

	  This package corresponds to the qtpndman project for OpenPandora.

	  http://qt.io
```
